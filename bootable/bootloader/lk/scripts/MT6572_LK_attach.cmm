; disable DABORT and PABORT breakpoint
;tronchip.set dabort off
;tronchip.set pabort off
;tronchip.set undef off
;tronchip.set irq off
;
; board init
;
;d.s c:0x10000000 %le %long 0x22000024
;do MT6572_EVB_DDR_DUAL.cmm

;D.S C15:0x1 0				; Turn off MMU

; disable wdt (debug purpose)
D.S SD:0x10007000 %LE %LONG 0x22000000

print "loading lk image"
d.load.elf ../build-mt6572_evb1/lk /gnu /nocode /RELPATH /PATH ".." 

;Y.SPATH.RESET ; reset all source path
;Y.SPATH.SRD ../app
;Y.SPATH.SRD ../app/mt_boot
;Y.SPATH.SRD ../arch/arm
;Y.SPATH.SRD ../dev
;Y.SPATH.SRD ../include
;Y.SPATH.SRD ../kernel
;Y.SPATH.SRD ../lib
;Y.SPATH.SRD ../../../../mediatek/platform/mt6572/lk

;d.s c:0x10208000 %le %long 0xe
;d.s c:0x10208100 %le %long 0x1
;d.s c:0x10208200 %le %long 0x1

d.l

enddo

