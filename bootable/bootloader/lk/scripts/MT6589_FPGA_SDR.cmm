; EMI setting
D.S SD:0x10203000 %LE %LONG 0x21102112; EMI_CONA
D.S SD:0x10203060 %LE %LONG 0x00000400; EMI_CONM

;  DDRPHY setting
D.S SD:0x10011048 %LE %LONG 0x0000110d;
D.S SD:0x100110D8 %LE %LONG 0x00500900;
D.S SD:0x100110E4 %LE %LONG 0x00000001;
D.S SD:0x1001108c %LE %LONG 0x00000001;
D.S SD:0x10011090 %LE %LONG 0x00000000;
D.S SD:0x10011094 %LE %LONG 0x80000000;
D.S SD:0x100110DC %LE %LONG 0x83004004;
D.S SD:0x100110E0 %LE %LONG 0x01004004;
D.S SD:0x100110F0 %LE %LONG 0x00000000;
D.S SD:0x100110F4 %LE %LONG 0x01000000;
D.S SD:0x10011168 %LE %LONG 0x00000080;
D.S SD:0x100110D8 %LE %LONG 0x00700900;
D.S SD:0x10011004 %LE %LONG 0xF00487A2;
D.S SD:0x1001107C %LE %LONG 0xA00641c0;
D.S SD:0x10011028 %LE %LONG 0xF1200F01;
D.S SD:0x100111E0 %LE %LONG 0x3001ebff;
D.S SD:0x10011158 %LE %LONG 0x00000000;
D.S SD:0x100110e4 %LE %LONG 0x00000005;
wait 1.ms
D.S SD:0x10011088 %LE %LONG 0x0000003F;
;D.S SD:0x100111E4 %LE %LONG 0x00000001;
;D.S SD:0x100111E4 %LE %LONG 0x00000000;
wait 1.ms
D.S SD:0x10011088 %LE %LONG 0x00FF000A;
;D.S SD:0x100111E4 %LE %LONG 0x00000001;
;D.S SD:0x100111E4 %LE %LONG 0x00000000;
wait 1.ms
D.S SD:0x10011088 %LE %LONG 0x00320001;
;D.S SD:0x100111E4 %LE %LONG 0x00000001;
;D.S SD:0x100111E4 %LE %LONG 0x00000000;
wait 1.ms
D.S SD:0x10011088 %LE %LONG 0x00020002;
;D.S SD:0x100111E4 %LE %LONG 0x00000001;
;D.S SD:0x100111E4 %LE %LONG 0x00001100;
wait 1.ms
D.S SD:0x10011110 %LE %LONG 0x00111190;
D.S SD:0x100110E4 %LE %LONG 0x00000001;
D.S SD:0x10011084 %LE %LONG 0x00000a56;
D.S SD:0x1001100C %LE %LONG 0x00000000;
D.S SD:0x10011000 %LE %LONG 0x45D84408;
D.S SD:0x10011044 %LE %LONG 0xa8080401;
D.S SD:0x100111E8 %LE %LONG 0x00000510;
D.S SD:0x10011008 %LE %LONG 0x03406340;
D.S SD:0x10011010 %LE %LONG 0x00000000;
D.S SD:0x100110F8 %LE %LONG 0xEDCB000F;
D.S SD:0x100110FC %LE %LONG 0x27010000;

; DRAMC setting
D.S SD:0x10004048 %LE %LONG 0x0000110d;
D.S SD:0x100040D8 %LE %LONG 0x00500900;
D.S SD:0x100040E4 %LE %LONG 0x00000001;
D.S SD:0x1000408c %LE %LONG 0x00000001;
D.S SD:0x10004090 %LE %LONG 0x00000000;
D.S SD:0x10004094 %LE %LONG 0x80000000;
D.S SD:0x100040DC %LE %LONG 0x83004004;
D.S SD:0x100040E0 %LE %LONG 0x01004004;
D.S SD:0x100040F0 %LE %LONG 0x00000000;
D.S SD:0x100040F4 %LE %LONG 0x01000000;
D.S SD:0x10004168 %LE %LONG 0x00000080;
D.S SD:0x100040D8 %LE %LONG 0x00700900;
D.S SD:0x10004004 %LE %LONG 0xF00487A2;
D.S SD:0x1000407C %LE %LONG 0xA00641c0;
D.S SD:0x10004028 %LE %LONG 0xF1200F01;
D.S SD:0x100041E0 %LE %LONG 0x3001ebff;
D.S SD:0x10004158 %LE %LONG 0x00000000;
D.S SD:0x100040e4 %LE %LONG 0x00000005;
;wait 1.ms
D.S SD:0x10004088 %LE %LONG 0x0000003F;
D.S SD:0x100041E4 %LE %LONG 0x00000001;
D.S SD:0x100041E4 %LE %LONG 0x00000000;
D.S SD:0x100041E4 %LE %LONG 0x00000000;
D.S SD:0x100041E4 %LE %LONG 0x00000000;
D.S SD:0x100041E4 %LE %LONG 0x00000000;
D.S SD:0x100041E4 %LE %LONG 0x00000000;
D.S SD:0x100041E4 %LE %LONG 0x00000000;
D.S SD:0x100041E4 %LE %LONG 0x00000000;
D.S SD:0x100041E4 %LE %LONG 0x00000000;
D.S SD:0x100041E4 %LE %LONG 0x00000000;
D.S SD:0x100041E4 %LE %LONG 0x00000000;
;wait 1.ms
D.S SD:0x10004088 %LE %LONG 0x00FF000A;
D.S SD:0x100041E4 %LE %LONG 0x00000001;
D.S SD:0x100041E4 %LE %LONG 0x00000000;
D.S SD:0x100041E4 %LE %LONG 0x00000000;
D.S SD:0x100041E4 %LE %LONG 0x00000000;
D.S SD:0x100041E4 %LE %LONG 0x00000000;
D.S SD:0x100041E4 %LE %LONG 0x00000000;
D.S SD:0x100041E4 %LE %LONG 0x00000000;
D.S SD:0x100041E4 %LE %LONG 0x00000000;
D.S SD:0x100041E4 %LE %LONG 0x00000000;
D.S SD:0x100041E4 %LE %LONG 0x00000000;
D.S SD:0x100041E4 %LE %LONG 0x00000000;
;wait 1.ms
D.S SD:0x10004088 %LE %LONG 0x00320001;
D.S SD:0x100041E4 %LE %LONG 0x00000001;
D.S SD:0x100041E4 %LE %LONG 0x00000000;
D.S SD:0x100041E4 %LE %LONG 0x00000000;
D.S SD:0x100041E4 %LE %LONG 0x00000000;
D.S SD:0x100041E4 %LE %LONG 0x00000000;
D.S SD:0x100041E4 %LE %LONG 0x00000000;
D.S SD:0x100041E4 %LE %LONG 0x00000000;
D.S SD:0x100041E4 %LE %LONG 0x00000000;
D.S SD:0x100041E4 %LE %LONG 0x00000000;
D.S SD:0x100041E4 %LE %LONG 0x00000000;
D.S SD:0x100041E4 %LE %LONG 0x00000000;
;wait 1.ms
D.S SD:0x10004088 %LE %LONG 0x00020002;
D.S SD:0x100041E4 %LE %LONG 0x00000001;
D.S SD:0x100041E4 %LE %LONG 0x00001100;
D.S SD:0x100041E4 %LE %LONG 0x00000000;
D.S SD:0x100041E4 %LE %LONG 0x00000000;
D.S SD:0x100041E4 %LE %LONG 0x00000000;
D.S SD:0x100041E4 %LE %LONG 0x00000000;
D.S SD:0x100041E4 %LE %LONG 0x00000000;
D.S SD:0x100041E4 %LE %LONG 0x00000000;
D.S SD:0x100041E4 %LE %LONG 0x00000000;
D.S SD:0x100041E4 %LE %LONG 0x00000000;
D.S SD:0x100041E4 %LE %LONG 0x00000000;
;wait 1.ms
D.S SD:0x10004110 %LE %LONG 0x00111190;
D.S SD:0x100040E4 %LE %LONG 0x00000001;
D.S SD:0x10004084 %LE %LONG 0x00000a56;
D.S SD:0x1000400C %LE %LONG 0x00000000;
D.S SD:0x10004000 %LE %LONG 0x45D84408;
D.S SD:0x10004044 %LE %LONG 0xa8080401;
D.S SD:0x100041E8 %LE %LONG 0x00000510;
D.S SD:0x10004008 %LE %LONG 0x03406340;
D.S SD:0x10004010 %LE %LONG 0x00000000;
D.S SD:0x100040F8 %LE %LONG 0xEDCB000F;
D.S SD:0x100040FC %LE %LONG 0x27010000;

enddo