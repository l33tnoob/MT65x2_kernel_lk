 &NR_CPUS=2

system.reset
SYSTEM.OPTION ENRESET ON
SYStem.Option ResBreak OFF
SYStem.Option WaitReset OFF
SYStem.JtagClock 10.MHz
if &NR_CPUS==1
(
SYSTEM.CPU CortexA7MPCore
)
else
(
    SYStem.CPU CortexA7MPCore
)

if &NR_CPUS==1
(

    ;Setting Core debug register access
    SYStem.CONFIG CORENUMBER 1;
    SYSTEM.MULTICORE COREBASE 0x80070000
)
else
(

;Setting Core debug register access
	SYSTEM.CONFIG CORENUMBER 2;
	core.assign 1 2 
    SYSTEM.MULTICORE COREBASE 0x80070000 0x80072000;
)

SYStem.Up

; disable DABORT and PABORT breakpoint
tronchip.set dabort off
tronchip.set pabort off
tronchip.set undef off
tronchip.set irq off
;
; board init
;
d.s c:0x10000000 %le %long 0x22000024
do MT6589_FPGA_SDR.cmm


D.S C15:0x1 0				; Turn off MMU

print "loading lk image"
d.load.elf ../build-mt6589_evb1/lk /gnu

Y.SPATH.RESET ; reset all source path
Y.SPATH.SRD ../app
Y.SPATH.SRD ../app/mt_boot
Y.SPATH.SRD ../arch/arm
Y.SPATH.SRD ../dev
Y.SPATH.SRD ../include
Y.SPATH.SRD ../kernel
Y.SPATH.SRD ../lib
Y.SPATH.SRD ../../../../mediatek/platform/mt6589/lk

;d.s c:0x10208000 %le %long 0xe
;d.s c:0x10208100 %le %long 0x1
;d.s c:0x10208200 %le %long 0x1

core.select 1
r.s pc 0x40

core.select 0
//enable GPT4 
d.s c:0x10008040 %le %long 0x000000001
d.l

enddo

