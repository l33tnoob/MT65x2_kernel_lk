 &NR_CPUS=1
 &RAM_BOOT=0

system.reset
SYSTEM.OPTION ENRESET ON
SYStem.Option ResBreak OFF
SYStem.Option WaitReset ON
SYStem.JtagClock 10.MHz
if &NR_CPUS==1
(
SYSTEM.CPU CortexA7MPCore
)
else
(
    SYStem.CPU CortexA7MPCore
)

if &NR_CPUS==1
(

    ;Setting Core debug register access
    SYStem.CONFIG CORENUMBER 1;
    SYSTEM.MULTICORE COREBASE 0x80070000
)
else
(

;Setting Core debug register access
	SYSTEM.CONFIG CORENUMBER 2;
	core.assign 1 2 
    SYSTEM.MULTICORE COREBASE 0x80070000 0x80072000;
)

;if OPT_JTAG == 0, parallel JTAG
;if OPT_JTAG == 1, serial JTAG
&OPT_JTAG=1
IF &OPT_JTAG==0
(
System.CONFIG SWDP OFF
)
ELSE IF &OPT_JTAG==1
(
System.CONFIG SWDP ON
)


SYStem.Up

; disable DABORT and PABORT breakpoint
tronchip.set dabort off
tronchip.set pabort off
tronchip.set undef off
tronchip.set irq off
;
; board init
;
;d.s c:0x10000000 %le %long 0x22000024
;do MT6572_EMI_Init.cmm
;do MT6572_PLL_Init.cmm 200
;do MT6572_EMI_Init.cmm LPDDR2-400

; disable wdt (debug purpose)
D.S SD:0x10007000 %LE %LONG 0x22000000

; enable gpt4
D.S SD:0x10008040 %LE %LONG 0x00000001

; setup boot augu from PL
if &RAM_BOOT==1
(
	do MT6572_PLL_Init.cmm 200
	do MT6572_EMI_Init.cmm LPDDR2-400

	R.S R4 0x800A0000
	D.S SD:0x800A0000 %LE %LONG 0x0
	D.S SD:0x800A0004 %LE %LONG 0x0
	D.S SD:0x800A0008 %LE %LONG 0x0
	D.S SD:0x800A000C %LE %LONG 0x11006000
	D.S SD:0x800A0010 %LE %LONG 0xE1000
	D.S SD:0x800A0014 %LE %LONG 0x1
	D.S SD:0x800A0018 %LE %LONG 0x1
	D.S SD:0x800A001C %LE %LONG 0xCB00000
)

;D.S C15:0x1 0				; Turn off MMU

;print "loading logo image"
;&logo_addr=0x8D900000;
;d.load.binary ../../../../mediatek/custom/common/lk/logo/wvga/wvga_uboot.bmp &logo_addr

print "loading lk image"
if &RAM_BOOT==0
(
	d.load.elf ../build-mt6572v1_phone/lk /gnu /nocode /RELPATH /PATH ".."
)
else
(
	d.load.elf ../build-mt6572v1_phone/lk /gnu /RELPATH /PATH ".."
)
Break.Select Program OnChip
Break.Select Hll OnChip
Break.Select Spot OnChip
Break.Select Read OnChip
Break.Select Write OnChip
;Y.SPATH.RESET ; reset all source path
;Y.SPATH.SRD ../app
;Y.SPATH.SRD ../app/mt_boot
;Y.SPATH.SRD ../arch/arm
;Y.SPATH.SRD ../dev
;Y.SPATH.SRD ../include
;Y.SPATH.SRD ../kernel
;Y.SPATH.SRD ../lib
;Y.SPATH.SRD ../../../../mediatek/platform/mt6572/lk

;d.s c:0x10208000 %le %long 0xe
;d.s c:0x10208100 %le %long 0x1
;d.s c:0x10208200 %le %long 0x1

;core.select 1
;r.s pc 0x40

;core.select 0
//enable GPT4 
;d.s c:0x10008040 %le %long 0x000000001
d.l

enddo

