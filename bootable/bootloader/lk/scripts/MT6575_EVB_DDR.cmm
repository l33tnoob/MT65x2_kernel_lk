&lpddr2=0	; LPDDR

D.S SD:0xC0003000 %LE %LONG 0x00022022	; 1 channel, dual rank, row 14b, bank 2b, column 10b, x32, total 512MB

IF &lpddr2==0  ; LPDDR
(
wait 200.us
D.S SD:0xC00040D4 %LE %LONG 0x00000008			//jitter calibration default value
wait 200.us
D.S SD:0xC00040B8 %LE %LONG 0x88008800			//Tx IO driving
D.S SD:0xC00040BC %LE %LONG 0x88008800			//Tx IO driving
D.S SD:0xC0004000 %LE %LONG 0x22824154

D.S SD:0xC0004048 %LE %LONG 0x0000110D;
D.S SD:0xC00040D8 %LE %LONG 0x40500900;
D.S SD:0xC000408C %LE %LONG 0x00000001;
D.S SD:0xC0004090 %LE %LONG 0x80000000;
D.S SD:0xC0004094 %LE %LONG 0xC0404040;		//dqs gating window: 0d64
D.S SD:0xC00040DC %LE %LONG 0x83002002;
D.S SD:0xC00040E0 %LE %LONG 0x00002002;
D.S SD:0xC00040F0 %LE %LONG 0x00000000;
D.S SD:0xC00040F4 %LE %LONG 0x10000000;		//1->PHYSYNM
D.S SD:0xC0004168 %LE %LONG 0x00000010;
D.S SD:0xC00040D8 %LE %LONG 0x40700900;
D.S SD:0xC0004004 %LE %LONG 0xF0040560;
D.S SD:0xC000407C %LE %LONG 0x8283405C;		//DLE
D.S SD:0xC0004028 %LE %LONG 0xF1200F01;
D.S SD:0xC00041E0 %LE %LONG 0x64000000;
D.S SD:0xC0004158 %LE %LONG 0x00000000;
D.S SD:0xC00040e4 %LE %LONG 0x00000000;
D.S SD:0xC00041e4 %LE %LONG 0x00000010;    //NOP enable
D.S SD:0xC00041e4 %LE %LONG 0x00000000;    //disable
D.S SD:0xC00041e4 %LE %LONG 0x00000004;    //PREA enable
D.S SD:0xC00041e4 %LE %LONG 0x00000000;    //disable
D.S SD:0xC00041e4 %LE %LONG 0x00000008;    //1st REF enable
D.S SD:0xC00041e4 %LE %LONG 0x00000000;    //disable
D.S SD:0xC00041e4 %LE %LONG 0x00000008;    //2nd REF enable
D.S SD:0xC00041e4 %LE %LONG 0x00000000;    //disable
D.S SD:0xC0004080 %LE %LONG 0x00000000;    //Select Mode Register
D.S SD:0xC0004088 %LE %LONG 0x00000032;    //BL=4,CAS Latency=3
D.S SD:0xC00041e4 %LE %LONG 0x00000001;    //MRS write enable
D.S SD:0xC00041e4 %LE %LONG 0x00000000;    //disable
D.S SD:0xC0004080 %LE %LONG 0x00800000;    //Select Extended Mode Register
D.S SD:0xC0004088 %LE %LONG 0x00000020;    //20-->1/2 dram drive, Extended Mode Register uses default values
D.S SD:0xC00041e4 %LE %LONG 0x00000001;    //MRS write enable
D.S SD:0xC00041e4 %LE %LONG 0x00001100;    //disable
D.S SD:0xC000400C %LE %LONG 0x00000000;
D.S SD:0xC0004044 %LE %LONG 0x9F068CA0;
D.S SD:0xC0004008 %LE %LONG 0x00403330;
D.S SD:0xC0004010 %LE %LONG 0x00000000;
D.S SD:0xC00040F8 %LE %LONG 0xEDCB000F;
D.S SD:0xC00040FC %LE %LONG 0x00000000;		//0-> sync mode

D.S SD:0xC0004210 %LE %LONG 0x00000000;		//RXDQ
D.S SD:0xC0004214 %LE %LONG 0x00000000;
D.S SD:0xC0004218 %LE %LONG 0x00000000;
D.S SD:0xC000421C %LE %LONG 0x00000000;
D.S SD:0xC0004220 %LE %LONG 0x00000000;
D.S SD:0xC0004224 %LE %LONG 0x00000000;
D.S SD:0xC0004228 %LE %LONG 0x00000000;
D.S SD:0xC000422C %LE %LONG 0x00000000;
D.S SD:0xC0004018 %LE %LONG 0x22222222;		//RXDQSI : gray(0d60)==22
D.S SD:0xC000403C %LE %LONG 0x01010000;
D.S SD:0xC0004040 %LE %LONG 0x00000080;
D.S SD:0xC0004048 %LE %LONG 0x0000d10d;
)

IF &lpddr2==1  ; LPDDR2
(
wait 200.us
D.S SD:0xC0003000 %LE %LONG 0x00022112	; 1 channel, dual rank, row 14b, bank 3b, column 9b, x32, total 512MB
D.S SD:0xC0004000 %LE %LONG 0x45D844B8;
D.S SD:0xC0004048 %LE %LONG 0x0000110D;
D.S SD:0xC00040D8 %LE %LONG 0x00500900;
D.S SD:0xC000408C %LE %LONG 0x00000001;
D.S SD:0xC0004090 %LE %LONG 0x00000000;
D.S SD:0xC0004094 %LE %LONG 0x80000000;
D.S SD:0xC00040DC %LE %LONG 0x82004004;
D.S SD:0xC00040E0 %LE %LONG 0x01004004;
D.S SD:0xC00040F0 %LE %LONG 0x00000000;
D.S SD:0xC00040F4 %LE %LONG 0x11000000;
D.S SD:0xC0004168 %LE %LONG 0x00000010;
D.S SD:0xC00040D8 %LE %LONG 0x00700900;
D.S SD:0xC0004004 %LE %LONG 0xF00407A0;
D.S SD:0xC000407C %LE %LONG 0xA0064150;
D.S SD:0xC0004028 %LE %LONG 0xF1200F01;
D.S SD:0xC00041E0 %LE %LONG 0x3101CFF5;
D.S SD:0xC0004158 %LE %LONG 0x00000000;
D.S SD:0xC0004088 %LE %LONG 0x003F0000;    //RESET
D.S SD:0xC00041e4 %LE %LONG 0x00000001;    //MRS write enable
D.S SD:0xC00041e4 %LE %LONG 0x00000000;    //disable
wait 1.us
D.S SD:0xC0004088 %LE %LONG 0x000A00FF;    //IO Calibration after Initialization
D.S SD:0xC00041e4 %LE %LONG 0x00000001;    //MRS write enable
D.S SD:0xC00041e4 %LE %LONG 0x00000000;    //disable
D.S SD:0xC0004088 %LE %LONG 0x00010032;    //nWR=3, No wrap, sequential, BL4
D.S SD:0xC00041e4 %LE %LONG 0x00000001;    //MRS write enable
D.S SD:0xC00041e4 %LE %LONG 0x00000000;    //disable
D.S SD:0xC0004088 %LE %LONG 0x00020002;    //RL=4, WL=2
D.S SD:0xC00041e4 %LE %LONG 0x00000001;    //MRS write enable
D.S SD:0xC00041e4 %LE %LONG 0x00001100;    //disable
D.S SD:0xC0004084 %LE %LONG 0x00000A56;
D.S SD:0xC000400C %LE %LONG 0x00000000;
D.S SD:0xC0004044 %LE %LONG 0x9F0E0401;
D.S SD:0xC0004008 %LE %LONG 0x00406340;
D.S SD:0xC0004010 %LE %LONG 0x00000000;
D.S SD:0xC00040F8 %LE %LONG 0xEDCB000F;
D.S SD:0xC00040FC %LE %LONG 0x00010000;
D.S SD:0xC00041DC %LE %LONG 0x20352842;
)

D.S SD:0xC0003060 %LE %LONG 0x00000400 ;ungate dram

