d.s asd:0x10000000 %le %long 0x22000024
