SYSTEM.RESET
SYSTEM.OPTION ENRESET ON
SYSTEM.OPTION RESBREAK OFF


SYSTEM.JTAGCLOCK 10.MHz

SYSTEM.CPU CortexA7MPCore

;R-T Memory Access
SYSTEM.MULTICORE MEMORYACCESSPORT 0
SYSTEM.MULTICORE DEBUGACCESSPORT 1

;Setting Core debug register access
SYSTEM.MULTICORE COREBASE APB:0x80070000
SYStem.Up
wait 200.us

D.S SD:0x10200100 %LE %LONG 0x00000100  ;L2C share SRAM need check !!!
; enable MSDC mode of (GPIO154-165) for eMMC
D.S SD:0x100057E0 %LE %LONG 0x00001000
D.S SD:0x100057F0 %LE %LONG 0x00001249
D.S SD:0x10005800 %LE %LONG 0x00001249
D.S SD:0x10005810 %LE %LONG 0x00000001

; set_hw_breakpoint_by_def
; setting attribute of breakpoints
Break.Select Program OnChip
Break.Select Hll OnChip
Break.Select Spot OnChip
Break.Select Read OnChip
Break.Select Write OnChip

D.S C15:0x1 0				; Turn off MMU

; disable wdt (debug purpose)
D.S SD:0x10007000 %LE %LONG 0x22000000

; board init
print "loading pre-loader image"
d.load.elf ../../bin/preloader.elf

Y.SPATH.RESET ; reset all source path
Y.SPATH.SRD ../../../platform/mt6595/preloader/src/init
Y.SPATH.SRD ../../../platform/mt6595/preloader/src/core
Y.SPATH.SRD ../../../platform/mt6595/preloader/src/drivers
Y.SPATH.SRD ../../../platform/mt6595/preloader/src/security
Y.SPATH.SRD ../../../custom/mt6595_evb/preloader
Y.SPATH.SRD ../../../protect-private/security/ASF/preloader


Break.Select Program OnChip
Break.Select Hll OnChip
Break.Select Spot OnChip
Break.Select Read OnChip
Break.Select Write OnChip

R.S T 0
;winclear
d.l
enddo
