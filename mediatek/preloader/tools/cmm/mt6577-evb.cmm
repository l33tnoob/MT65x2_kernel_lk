SYSTEM.RESET
SYSTEM.OPTION ENRESET ON
SYSTEM.OPTION RESBREAK OFF
SYSTEM.OPTION WAITRESET ON

SYSTEM.JTAGCLOCK 10.MHz

SYSTEM.CPU CortexA9MPCore

;R-T Memory Access
SYSTEM.MULTICORE MEMORYACCESSPORT 0
SYSTEM.MULTICORE DEBUGACCESSPORT 1

;Setting PTM
;SYSTEM.MULTICORE ETMBASE APB:0x8007C000

;Setting ETB
;SYSTEM.MULTICORE ETBBASE APB:0x80001000

;Setting TPIU
;SYSTEM.MULTICORE TPIUBASE APB:0x80013000

;Setting Funnel
;SYSTEM.MULTICORE FUNNELBASE APB:0x80014000 
;SYSTEM.MULTICORE ETMFUNNELPORT 0

;Setting Core debug register access
SYSTEM.MULTICORE COREBASE APB:0x80070000 0x8007200
ConnectGo
wait 200.ms
break

; Initialize EMI
&init_emi=0 ; 0: not init 
            ; 1: init 
IF &init_emi==1
(
    D.S SD:0xC0007120 %LE %LONG 0x2860	; MAINPLL 1066Mhz
    wait 120.ms							; wait 120us (min delay is 30us)
    D.S SD:0xC0007140 %LE %LONG 0x2B40	; ISPPLL 143MHz
    wait 80.ms							; wait 80us (min delay is 20us)
    D.S SD:0xC0007160 %LE %LONG 0x1710	; USBPLL 624MHz (for USB 2.0 and 1.0 Phy)
    wait 80.ms							; wait 80us (min delay is 20us)
    D.S SD:0xC0007160 %LE %LONG 0x1712	; Set USBPLL to 48Mhz output enable
    D.S SD:0xC0007180 %LE %LONG 0x1310	; MDPLL 1024MHz
    wait 80.ms							; wait 80us (min delay is 20us)
    D.S SD:0xC0007180 %LE %LONG 0x1312	; Set MDPLL to 297.14Mhz output enable
    D.S SD:0xC00071C0 %LE %LONG 0x403B	; 3GPLL 197Mhz, 492Mhz, 61Mhz enable
    wait 120.ms							; wait 120us (min delay is 30us)
    D.S SD:0xC00071C0 %LE %LONG 0x403F	; 3GPLL 197Mhz, 281Mhz, 492Mhz, 61Mhz enable
    D.S SD:0xC0007144 %LE %LONG 0x4113	; Reference clock is from ANA 26Mhz (Clock to MEMPLL enable)
    
	D.S SD:0xC0007200 %LE %LONG 0x0910	; 1040Mhz
    D.S SD:0xC0007204 %LE %LONG 0x0026	; MEMPLL = 1040Mhz/4 = 260Mhz
	wait 80.ms							; wait 80us (min delay is 20us)

    D.S SD:0xC0001014 %LE %LONG 0x100	; Set clock divider and turn on enable generator
    D.S SD:0xC0001004 %LE %LONG 0x8		; BUS clock will divide by 4 (01) but ARMPLL will divide by 1 (000)
    D.S SD:0xC0001000 %LE %LONG 0x1		; CortexA9 (Mux3 From Mux1), ARM (Mux1 using ARMPLL), Bus (Mux0 using MAINPLL)

    wait 200.ms

    ; EMI setting
    D.S SD:0xC0003000 %LE %LONG 0x21102112; EMI_CONA
    D.S SD:0xC0003060 %LE %LONG 0x00000400; EMI_CONM

    ; DRAMC setting
    D.S SD:0xC00040D8 %LE %LONG 0x00500900;
    D.S SD:0xC000408c %LE %LONG 0x00000001;
    D.S SD:0xC0004094 %LE %LONG 0x80000000;
    D.S SD:0xC00040DC %LE %LONG 0x82004004;
    D.S SD:0xC00040E0 %LE %LONG 0x01004004;
    D.S SD:0xC00040F4 %LE %LONG 0x01000000;
    D.S SD:0xC00040D8 %LE %LONG 0x00700900;

    D.S SD:0xC0004004 %LE %LONG 0xF00407A0;
    D.S SD:0xC000407C %LE %LONG 0xA0064150;
    D.S SD:0xC0004028 %LE %LONG 0xF1200F01;
    D.S SD:0xC00041E0 %LE %LONG 0x3101CFF5;
    D.S SD:0xC0004158 %LE %LONG 0x00000000;

    wait 200.ms

    D.S SD:0xC0004088 %LE %LONG 0x003F0000;
    D.S SD:0xC00041E4 %LE %LONG 0x00000001;
    D.S SD:0xC00041E4 %LE %LONG 0x00000000;

    wait 200.ms

    D.S SD:0xC0004088 %LE %LONG 0x000A00FF;
    D.S SD:0xC00041E4 %LE %LONG 0x00000001;
    D.S SD:0xC00041E4 %LE %LONG 0x00000000;

    wait 200.ms

    D.S SD:0xC0004088 %LE %LONG 0x00010032;
    D.S SD:0xC00041E4 %LE %LONG 0x00000001;
    D.S SD:0xC00041E4 %LE %LONG 0x00000000;

    wait 200.ms

    D.S SD:0xC0004088 %LE %LONG 0x00020002;
    D.S SD:0xC00041E4 %LE %LONG 0x00000001;
    D.S SD:0xC00041E4 %LE %LONG 0x00001100;

    wait 200.ms

    D.S SD:0xC0004000 %LE %LONG 0x45D84408;
    D.S SD:0xC0004044 %LE %LONG 0x9F0E0401;
    D.S SD:0xC0004008 %LE %LONG 0x00406303;
    D.S SD:0xC00040F8 %LE %LONG 0xEDCB000F;
    
    ; EMI_ARBA = 0x8008d90e
	D.S SD:0xC0003100 %LE %LONG 0x8008d90e
	; EMI_ARBB = 0x80080000
	D.S SD:0xC0003108 %LE %LONG 0x80080000
	; EMI_ARBC = 0x80405803
	D.S SD:0xC0003110 %LE %LONG 0x80405803
	; EMI_ARBD = 0x4008d010
	D.S SD:0xC0003118 %LE %LONG 0x4008d010
	; EMI_ARBE = 0x80105003
	D.S SD:0xC0003120 %LE %LONG 0x80105003
	; EMI_ARBF = 0x80405003
	D.S SD:0xC0003128 %LE %LONG 0x80405003
	; EMI_ARBG = 0x8040501f 
	D.S SD:0xC0003130 %LE %LONG 0x8040501f
	; EMI_ARBI = 0x01214480
)

; set_hw_breakpoint_by_def
; setting attribute of breakpoints
Break.Select Program OnChip
Break.Select Hll OnChip
Break.Select Spot OnChip
Break.Select Read OnChip
Break.Select Write OnChip

D.S C15:0x1 0				; Turn off MMU

;Disable WDT
D.S C:0xC0000000 %LE %LONG 0x2224
;D.S SD:0xC0000000 %LE %LONG 0x00002226 ;disable wdt

; board init
print "loading pre-loader image"
d.load.elf ../../bin/preloader_mt6577_evb.elf

Y.SPATH.RESET ; reset all source path
Y.SPATH.SRD ../../../platform/mt6577/preloader/src/init
Y.SPATH.SRD ../../../platform/mt6577/preloader/src/core
Y.SPATH.SRD ../../../platform/mt6577/preloader/src/drivers
Y.SPATH.SRD ../../../platform/mt6577/preloader/src/security
Y.SPATH.SRD ../../../custom/mt6577_evb/preloader

R.S T 0

;winclear

b.reset

d.l
b.s main
go

enddo
