SYSTEM.RESET
SYSTEM.OPTION ENRESET ON
SYSTEM.OPTION RESBREAK OFF
SYSTEM.OPTION WAITRESET ON

SYSTEM.JTAGCLOCK 10.MHz

SYSTEM.CPU CortexA7MPCore

;R-T Memory Access
SYSTEM.MULTICORE MEMORYACCESSPORT 0
SYSTEM.MULTICORE DEBUGACCESSPORT 1

;Setting Core debug register access
SYSTEM.MULTICORE COREBASE APB:0x80070000
SYStem.Up
wait 200.us

; Initialize EMI
&init_emi=1 ; 0: not init 
            ; 1: init 
IF &init_emi==1
(
; EMI setting
;D.S SD:0x10203000 %LE %LONG 0x21102112; EMI_CONA
;D.S SD:0x10203060 %LE %LONG 0x00000400; EMI_CONM
D.S SD:0x10203000 %LE %LONG 0x0000A35A; EMI_CONA
D.S SD:0x10203060 %LE %LONG 0x00000700; EMI_CONM
D.S SD:0x10203140 %LE %LONG 0x10402488; EMI_ARBI
D.S SD:0x10203100 %LE %LONG 0x4010580e; EMI_ARBA
D.S SD:0x10203110 %LE %LONG 0xffff5803; EMI_ARBC
D.S SD:0x10203118 %LE %LONG 0x0601580e; EMI_ARBD
D.S SD:0x10203120 %LE %LONG 0x40405003; EMI_ARBE
D.S SD:0x10203128 %LE %LONG 0x8080500f; EMI_ARBF
D.S SD:0x10203130 %LE %LONG 0x8080500f; EMI_ARBG
D.S SD:0x10203148 %LE %LONG 0x00464f2f; EMI_ARBJ
D.S SD:0x10203150 %LE %LONG 0x00720038; EMI_ARBK
D.S SD:0x10203158 %LE %LONG 0x0808084d; EMI_SLCT
    
; DDRPHY setting
D.S SD:0x10011048 %LE %LONG 0x0000110d;
D.S SD:0x100110D8 %LE %LONG 0x00500900;
D.S SD:0x100110E4 %LE %LONG 0x00000001;
D.S SD:0x1001108c %LE %LONG 0x00000001;
D.S SD:0x10011090 %LE %LONG 0x00000000;
D.S SD:0x10011094 %LE %LONG 0x80000000;
D.S SD:0x100110DC %LE %LONG 0x83004004;
D.S SD:0x100110E0 %LE %LONG 0x01004004;
D.S SD:0x100110F0 %LE %LONG 0x00000000;
D.S SD:0x100110F4 %LE %LONG 0x01000000;
D.S SD:0x10011168 %LE %LONG 0x00000080;
D.S SD:0x100110D8 %LE %LONG 0x00700900;
D.S SD:0x10011004 %LE %LONG 0xF00487A2;
D.S SD:0x1001107C %LE %LONG 0xA00641c0;
D.S SD:0x10011028 %LE %LONG 0xF1200F01; 
D.S SD:0x100111E0 %LE %LONG 0x3001ebff;
D.S SD:0x10011158 %LE %LONG 0x00000000;
D.S SD:0x100110e4 %LE %LONG 0x00000005;
wait 1.ms
D.S SD:0x10011088 %LE %LONG 0x0000003F;
;D.S SD:0x100111E4 %LE %LONG 0x00000001;
;D.S SD:0x100111E4 %LE %LONG 0x00000000;
wait 1.ms
D.S SD:0x10011088 %LE %LONG 0x00FF000A;
;D.S SD:0x100111E4 %LE %LONG 0x00000001;
;D.S SD:0x100111E4 %LE %LONG 0x00000000;
wait 1.ms
D.S SD:0x10011088 %LE %LONG 0x00320001;
;D.S SD:0x100111E4 %LE %LONG 0x00000001;
;D.S SD:0x100111E4 %LE %LONG 0x00000000;
wait 1.ms
D.S SD:0x10011088 %LE %LONG 0x00020002;
;D.S SD:0x100111E4 %LE %LONG 0x00000001;
;D.S SD:0x100111E4 %LE %LONG 0x00001100;
wait 1.ms
D.S SD:0x10011110 %LE %LONG 0x00111190;
D.S SD:0x100110E4 %LE %LONG 0x00000001;
D.S SD:0x10011084 %LE %LONG 0x00000a56;
D.S SD:0x1001100C %LE %LONG 0x00000000;
D.S SD:0x10011000 %LE %LONG 0x45D84408;
D.S SD:0x10011044 %LE %LONG 0xa8080401;
D.S SD:0x100111E8 %LE %LONG 0x00000510;
D.S SD:0x10011008 %LE %LONG 0x03406340;
D.S SD:0x10011010 %LE %LONG 0x00000000;
D.S SD:0x100110F8 %LE %LONG 0xEDCB000F;
D.S SD:0x100110FC %LE %LONG 0x27010000;

; DRAMC setting
D.S SD:0x10004048 %LE %LONG 0x0000110d;
D.S SD:0x100040D8 %LE %LONG 0x00500900;
D.S SD:0x100040E4 %LE %LONG 0x00000001;
D.S SD:0x1000408c %LE %LONG 0x00000001;
D.S SD:0x10004090 %LE %LONG 0x00000000;
D.S SD:0x10004094 %LE %LONG 0x80000000;
D.S SD:0x100040DC %LE %LONG 0x83004004;
D.S SD:0x100040E0 %LE %LONG 0x01004004;
D.S SD:0x100040F0 %LE %LONG 0x00000000;
D.S SD:0x100040F4 %LE %LONG 0x01000000;
D.S SD:0x10004168 %LE %LONG 0x00000080;
D.S SD:0x100040D8 %LE %LONG 0x00700900;
D.S SD:0x10004004 %LE %LONG 0xF00487A2;
D.S SD:0x1000407C %LE %LONG 0xA00641c0;
D.S SD:0x10004028 %LE %LONG 0xF1200F01;
D.S SD:0x100041E0 %LE %LONG 0x3001ebff;
D.S SD:0x10004158 %LE %LONG 0x00000000;
D.S SD:0x100040e4 %LE %LONG 0x00000005;
;wait 1.ms
D.S SD:0x10004088 %LE %LONG 0x0000003F;
D.S SD:0x100041E4 %LE %LONG 0x00000001;
D.S SD:0x100041E4 %LE %LONG 0x00000000;
D.S SD:0x100041E4 %LE %LONG 0x00000000;
D.S SD:0x100041E4 %LE %LONG 0x00000000;
D.S SD:0x100041E4 %LE %LONG 0x00000000;
D.S SD:0x100041E4 %LE %LONG 0x00000000;
D.S SD:0x100041E4 %LE %LONG 0x00000000;
D.S SD:0x100041E4 %LE %LONG 0x00000000;
D.S SD:0x100041E4 %LE %LONG 0x00000000;
D.S SD:0x100041E4 %LE %LONG 0x00000000;
D.S SD:0x100041E4 %LE %LONG 0x00000000;
;wait 1.ms
D.S SD:0x10004088 %LE %LONG 0x00FF000A;
D.S SD:0x100041E4 %LE %LONG 0x00000001;
D.S SD:0x100041E4 %LE %LONG 0x00000000;
D.S SD:0x100041E4 %LE %LONG 0x00000000;
D.S SD:0x100041E4 %LE %LONG 0x00000000;
D.S SD:0x100041E4 %LE %LONG 0x00000000;
D.S SD:0x100041E4 %LE %LONG 0x00000000;
D.S SD:0x100041E4 %LE %LONG 0x00000000;
D.S SD:0x100041E4 %LE %LONG 0x00000000;
D.S SD:0x100041E4 %LE %LONG 0x00000000;
D.S SD:0x100041E4 %LE %LONG 0x00000000;
D.S SD:0x100041E4 %LE %LONG 0x00000000;
;wait 1.ms
D.S SD:0x10004088 %LE %LONG 0x00320001;
D.S SD:0x100041E4 %LE %LONG 0x00000001;
D.S SD:0x100041E4 %LE %LONG 0x00000000;
D.S SD:0x100041E4 %LE %LONG 0x00000000;
D.S SD:0x100041E4 %LE %LONG 0x00000000;
D.S SD:0x100041E4 %LE %LONG 0x00000000;
D.S SD:0x100041E4 %LE %LONG 0x00000000;
D.S SD:0x100041E4 %LE %LONG 0x00000000;
D.S SD:0x100041E4 %LE %LONG 0x00000000;
D.S SD:0x100041E4 %LE %LONG 0x00000000;
D.S SD:0x100041E4 %LE %LONG 0x00000000;
D.S SD:0x100041E4 %LE %LONG 0x00000000;
;wait 1.ms
D.S SD:0x10004088 %LE %LONG 0x00020002;
D.S SD:0x100041E4 %LE %LONG 0x00000001;
D.S SD:0x100041E4 %LE %LONG 0x00001100;
D.S SD:0x100041E4 %LE %LONG 0x00000000;
D.S SD:0x100041E4 %LE %LONG 0x00000000;
D.S SD:0x100041E4 %LE %LONG 0x00000000;
D.S SD:0x100041E4 %LE %LONG 0x00000000;
D.S SD:0x100041E4 %LE %LONG 0x00000000;
D.S SD:0x100041E4 %LE %LONG 0x00000000;
D.S SD:0x100041E4 %LE %LONG 0x00000000;
D.S SD:0x100041E4 %LE %LONG 0x00000000;
D.S SD:0x100041E4 %LE %LONG 0x00000000;
;wait 1.ms
D.S SD:0x10004110 %LE %LONG 0x00111190;
D.S SD:0x100040E4 %LE %LONG 0x00000001;
D.S SD:0x10004084 %LE %LONG 0x00000a56;
D.S SD:0x1000400C %LE %LONG 0x00000000;
D.S SD:0x10004000 %LE %LONG 0x45D84408;
D.S SD:0x10004044 %LE %LONG 0xa8080401;
D.S SD:0x100041E8 %LE %LONG 0x00000510;
D.S SD:0x10004008 %LE %LONG 0x03406340;
D.S SD:0x10004010 %LE %LONG 0x00000000;
D.S SD:0x100040F8 %LE %LONG 0xEDCB000F;
D.S SD:0x100040FC %LE %LONG 0x27010000;
)

; MSDC FPGA DTB: Card power(GPIO3), MSDC Bus 3.3V(GPIO2), MSDC Bus 1.8V(GPIO1) control
; Set GPIO direction
D.S SD:0x10001E88 %LE %LONG 0xFF00
; Set GPIO output value
D.S SD:0x10001E84 %LE %LONG 0x5500

; FPGA workaround (To be removed) {
d.s c:0x10208000 %le %long 0xe
d.s c:0x10208100 %le %long 0x1
d.s c:0x10208200 %le %long 0x1
; FPGA workaround (To be removed) }

; set_hw_breakpoint_by_def
; setting attribute of breakpoints
Break.Select Program OnChip
Break.Select Hll OnChip
Break.Select Spot OnChip
Break.Select Read OnChip
Break.Select Write OnChip

D.S C15:0x1 0				; Turn off MMU

; disable wdt (debug purpose)
D.S SD:0x10000000 %LE %LONG 0x22002224

; board init
print "loading pre-loader image"
d.load.elf ../../bin/preloader_mt6589_fpga.elf

Y.SPATH.RESET ; reset all source path
Y.SPATH.SRD ../../../../platform/mt6589/preloader/src/init
Y.SPATH.SRD ../../../../platform/mt6589/preloader/src/core
Y.SPATH.SRD ../../../../platform/mt6589/preloader/src/drivers
Y.SPATH.SRD ../../../../platform/mt6589/preloader/src/security
Y.SPATH.SRD ../../../../custom/mt6589_fpga/preloader

;winclear

b.reset

d.l
b.s main
go

enddo
