 &NR_CPUS=1

system.reset
SYSTEM.OPTION ENRESET ON
SYStem.Option ResBreak OFF
SYStem.Option WaitReset ON
SYStem.JtagClock 10.MHz
if &NR_CPUS==1
(
SYSTEM.CPU CortexA7MPCore
)
else
(
    SYStem.CPU CortexA7MPCore
)

if &NR_CPUS==1
(

    ;Setting Core debug register access
    SYStem.CONFIG CORENUMBER 1;
    SYSTEM.MULTICORE COREBASE 0x80070000
)
else
(

;Setting Core debug register access
	SYSTEM.CONFIG CORENUMBER 2;
	core.assign 1 2
    SYSTEM.MULTICORE COREBASE 0x80070000 0x80072000;
)

;if OPT_JTAG == 0, parallel JTAG
;if OPT_JTAG == 1, serial JTAG
&OPT_JTAG=1
IF &OPT_JTAG==0
(
System.CONFIG SWDP OFF
)
ELSE IF &OPT_JTAG==1
(
System.CONFIG SWDP ON
)


SYStem.Up

; disable DABORT and PABORT breakpoint
tronchip.set dabort off
tronchip.set pabort off
tronchip.set undef off
tronchip.set irq off

; board init




; disable wdt (debug purpose)
D.S SD:0x10007000 %LE %LONG 0x22000000
; set L2 as share memory (128 KB, Preloader is placed in L2)
D.S SD:0x10200000 %LE %LONG 0x00000000
;D.S C15:0x1 0				; Turn off MMU

; board init
print "loading pre-loader image"
d.load.elf ../../bin/preloader_mt6572v1_phone.elf /nocode

Break.Select Program OnChip
Break.Select Hll OnChip
Break.Select Spot OnChip
Break.Select Read OnChip
Break.Select Write OnChip
Y.SPATH.RESET ; reset all source path
Y.SPATH.SRD ../../../platform/mt6572/preloader/src/init
Y.SPATH.SRD ../../../platform/mt6572/preloader/src/core
Y.SPATH.SRD ../../../platform/mt6572/preloader/src/drivers
Y.SPATH.SRD ../../../platform/mt6572/preloader/src/security
Y.SPATH.SRD ../../../custom/mt6572_fpga/preloader

;d.s c:0x10208000 %le %long 0xe
;d.s c:0x10208100 %le %long 0x1
;d.s c:0x10208200 %le %long 0x1

;core.select 1
;r.s pc 0x40

;core.select 0
;enable GPT4
;d.s c:0x10008040 %le %long 0x000000001
;d.l
;b.s main

enddo
