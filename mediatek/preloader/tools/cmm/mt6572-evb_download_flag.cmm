 &NR_CPUS=1
 &RAM_BOOT=1

system.reset
SYSTEM.OPTION ENRESET ON
SYStem.Option ResBreak OFF
SYStem.Option WaitReset OFF
SYStem.JtagClock 10.MHz
if &NR_CPUS==1
(
SYSTEM.CPU CortexA7MPCore
)
else
(
    SYStem.CPU CortexA7MPCore
)

if &NR_CPUS==1
(

    ;Setting Core debug register access
    SYStem.CONFIG CORENUMBER 1;
    SYSTEM.MULTICORE COREBASE 0x80070000
)
else
(

;Setting Core debug register access
	SYSTEM.CONFIG CORENUMBER 2;
	core.assign 1 2
    SYSTEM.MULTICORE COREBASE 0x80070000 0x80072000;
)

SYStem.Up
;wait 200.us

; disable DABORT and PABORT breakpoint
tronchip.set dabort off
tronchip.set pabort off
tronchip.set undef off
tronchip.set irq off

; board init
if &RAM_BOOT==1
(
	do MT6572_PLL_Init.cmm 200
	do MT6572_EMI_Init.cmm LPDDR2-400
)



; disable wdt (debug purpose)
D.S SD:0x10007000 %LE %LONG 0x22000000
; set L2 as share memory (128 KB, Preloader is placed in L2)
D.S SD:0x10200000 %LE %LONG 0x00000000
;D.S C15:0x1 0				; Turn off MMU

; board init
;Place pre-loader for memory preserved mode into internal RAM

;Indicate memory preserved mode is on
;D.S SD:0x10007040 %LE %LONG 0x59000100
;Magic number for memory preserved mode
;D.S SD:0x10001428 %LE %LONG 0x504D454D
;Address of pre-loader for memory preserved mode
;D.S SD:0x10001424 %LE %LONG 0x01000000

D.S SD:0x1000141C %LE %LONG 0x1
D.S SD:0x10001420 %LE %LONG 0x55534244

;*USBDL_FLAG=1; //enter BOOTROM USBDL by flag
;*USBDL_MAGIC_REG=0x55534244; //fill in BOOTROM USBDL by flag magic number
;D.LOAD.BINARY   .\..\Bin\RTLSIM_MBL_RAMDISK_10KB.bin 0x01000000 /long
D.LOAD.BINARY   ..\..\Download\flash\preloader_mt6572_evb1.bin_mem 0x80100000 /long

print "loading mem pre-loader image"

print "loading pre-loader image"
;d.load.elf ../../bin/preloader_mt6572_evb1.elf 

Y.SPATH.RESET ; reset all source path
Y.SPATH.SRD ../../../platform/mt6572/preloader/src/init
Y.SPATH.SRD ../../../platform/mt6572/preloader/src/core
Y.SPATH.SRD ../../../platform/mt6572/preloader/src/drivers
Y.SPATH.SRD ../../../platform/mt6572/preloader/src/security
Y.SPATH.SRD ../../../custom/mt6572_fpga/preloader

;d.s c:0x10208000 %le %long 0xe
;d.s c:0x10208100 %le %long 0x1
;d.s c:0x10208200 %le %long 0x1

;core.select 1
;r.s pc 0x40

;core.select 0
;enable GPT4
;d.s c:0x10008040 %le %long 0x000000001
;d.l
;b.s main

enddo
