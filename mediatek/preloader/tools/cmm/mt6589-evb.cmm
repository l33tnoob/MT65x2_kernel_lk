 &NR_CPUS=2

system.reset
SYSTEM.OPTION ENRESET ON
SYStem.Option ResBreak OFF
SYStem.Option WaitReset OFF
SYStem.JtagClock 10.MHz
if &NR_CPUS==1
(
SYSTEM.CPU CortexA7MPCore
)
else
(
    SYStem.CPU CortexA7MPCore
)

if &NR_CPUS==1
(

    ;Setting Core debug register access
    SYStem.CONFIG CORENUMBER 1;
    SYSTEM.MULTICORE COREBASE 0x80070000
)
else
(

;Setting Core debug register access
	SYSTEM.CONFIG CORENUMBER 2;
	core.assign 1 2 
    SYSTEM.MULTICORE COREBASE 0x80070000 0x80072000;
)

SYStem.Up

; disable DABORT and PABORT breakpoint
tronchip.set dabort off
tronchip.set pabort off
tronchip.set undef off
tronchip.set irq off
;

D.S C15:0x1 0				; Turn off MMU

; board init
d.s c:0x10000000 %le %long 0x22002224
print "loading pre-loader image"
d.load.elf ../../bin/preloader_mt6589_evb1.elf

;d.s c:0x10005C00 %le %long 0x00001249
;d.s c:0x10005C10 %le %long 0x00001249

Y.SPATH.RESET ; reset all source path
Y.SPATH.SRD ../../../platform/mt6589/preloader/src/init
Y.SPATH.SRD ../../../platform/mt6589/preloader/src/core
Y.SPATH.SRD ../../../platform/mt6589/preloader/src/drivers
Y.SPATH.SRD ../../../platform/mt6589/preloader/src/security
Y.SPATH.SRD ../../../custom/mt6589_fpga/preloader

;winclear

;b.reset

d.l
;b.s main
;go

enddo
